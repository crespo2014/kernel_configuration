## 311c/nvidia-ion/Kconfig
```kconfig
#
# NVidia ION Display controller
#
config NVIDIA_ION
	tristate "Nvidia ION LE for netbook"
	select DRM
	---help---
	Nvida ion is the video card for 311c

if NVIDIA_ION

config NVIDIA_UVM
	bool "Enable CUDA Support"
	default n

if NVIDIA_UVM

config NVIDIA_ION_UVM_LITE
	bool "Enable lite mode"
	default n
	
config NVIDIA_ION_UVM_NEXT
	bool "Enable uvm next mode"
	default n
	
endif #NVIDIA_UVM	


endif # NVIDIA_ION
```

## src/drivers/Kconfig
```kconfig
#
#
config ASYNCHRO_MODULE_INIT
	tristate "Initialize module in Asynchronize way using single module dependencies"
	---help---
	Asynchrone drivers initialization routine 
	
if ASYNCHRO_MODULE_INIT
	config ASYNCHRO_MODULE_INIT_DEBUG
	bool "Debug mode"
	
config ASYNCHRO_MODULE_INIT_THREADS	
	int "Maximum number of threads"
	range 1 4
	default "2" 
endif
```

## src/drivers/gpu/drm/Kconfig
```kconfig
source "drivers/gpu/drm/nouveau/Kconfig"
+ source "drivers/gpu/drm/nvidia-geforce/Kconfig"
source "drivers/gpu/drm/i915/Kconfig"
```

## src/drivers/gpu/drm/nvidia-geforce-450.66/Kconfig
```kconfig
#
# NVidia Display controller
#
config NVIDIA_GEFORCE
	tristate "Nvidia Geforce"
	select DRM
	help
	   Nvida Geforce is the nvidia diver for geforce cards
	
```

## src/drivers/gpu/drm/nvidia-geforce/Kconfig
```kconfig
#
# NVidia Display controller
#
config NVIDIA_GEFORCE
	tristate "Nvidia Geforce"
	select DRM
	---help---
	Nvida Geforce is the nvidia diver for geforce cards
	
if NVIDIA_GEFORCE

config NVIDIA_UVM_RM
	bool "Enable Nvidia RM"
	default y
	---help---
	You need this option enable in order to compile nvidia uvm driver that brings cuda support

config NVIDIA_UVM
	tristate "Enable CUDA Support"
	depends on NVIDIA_UVM_RM
	
choice
 	prompt "UVM module type"
 	default NVIDIA_ION_UVM_LITE
 	depends on NVIDIA_UVM
 	
config NVIDIA_ION_UVM_LITE
	bool "Only lite mode"
	
config NVIDIA_ION_UVM_NEXT
	bool "Only uvm next mode"
	
config NVIDIA_ION_UVM_ALL
    bool "Both modes lite and next"
	
 	
endchoice 	
	
endif # NVIDIA_ION
```

## src/drivers/gpu/drm/nvidia-ion/Kconfig
```kconfig
#
# NVidia ION Display controller
#
config NVIDIA_ION
	tristate "Nvidia ION LE for netbook"
	select DRM
	---help---
	Nvida ion is the video card for 311c
	
if NVIDIA_ION

config NVIDIA_UVM_RM
	bool "Enable Nvidia RM"
	default y
	---help---
	You need this option enable in order to compile nvidia uvm driver that brings cuda support

config NVIDIA_UVM
	tristate "Enable CUDA Support"
	depends on NVIDIA_UVM_RM
	
choice
 	prompt "UVM module type"
 	default NVIDIA_ION_UVM_LITE
 	depends on NVIDIA_UVM
 	
config NVIDIA_ION_UVM_LITE
	bool "Only lite mode"
	
config NVIDIA_ION_UVM_NEXT
	bool "Only uvm next mode"
	
config NVIDIA_ION_UVM_ALL
    bool "Both modes lite and next"
	
 	
endchoice 	
	
if NVIDIA_UVM


	

	
endif #NVIDIA_UVM	


endif # NVIDIA_ION
```

## src/drivers/net/r8168-8.040.00/Kconfig
```kconfig
#
# Realtek Ethernet controllers
#
config RTL8168
	tristate "RealTek RTL8168B/8111B, RTL8168C/8111C, RTL8168CP/8111CP, RTL8168D/8111D, RTL8168DP/8111DP, and RTL8168E/8111E Gigabit Ethernet controllers with PCI-Express interface"
	depends on PCI
	select CRC32
	select MII
	---help---
	r8168 is the Linux device driver released for Realtek Gigabit Ethernet
	controllers with PCI-Express interface.
	http://www.realtek.com.tw/products/productsView.aspx?Langid=1&PFid=5&Level=5&Conn=4&ProdID=12

if RTL8168

config ENABLE_REALWOW_SUPPORT
	bool "ENABLE_REALWOW_SUPPORT"
	default n
	
config ENABLE_DASH_SUPPORT
	bool "ENABLE_DASH_SUPPORT"
	default n

config CONFIG_DOWN_SPEED_100
	bool "CONFIG_DOWN_SPEED_100"
	default n
	
config CONFIG_ASPM
	bool "CONFIG_ASPM"
	default y
	
config ENABLE_S5WOL
	bool "ENABLE_S5WOL"
	default y
	
config ENABLE_EEE
	bool "ENABLE_EEE"
	default n


endif # RTL8111
```
